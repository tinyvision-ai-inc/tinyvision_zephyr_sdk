/*
 * Copyright (c) 2025 tinyVision.ai Inc.
 *
 * SPDX-License-Identifier: Apache-2.0
 */

&csi1 { status = "okay"; };
&stacker { status = "okay"; };

&csi1_ep_out2 {
	remote-endpoint-label = "stacker_ep_in1";
};

&stacker_ep_in1 {
	remote-endpoint-label = "csi1_ep_out2";
};
