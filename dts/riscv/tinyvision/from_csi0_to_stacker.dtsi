/*
 * Copyright (c) 2025 tinyVision.ai Inc.
 *
 * SPDX-License-Identifier: Apache-2.0
 */

&csi0 { status = "okay"; };
&stacker { status = "okay"; };

&csi0_ep_out2 {
	remote-endpoint-label = "stacker_ep_in0";
};

&stacker_ep_in0 {
	remote-endpoint-label = "csi0_ep_out2";
};
