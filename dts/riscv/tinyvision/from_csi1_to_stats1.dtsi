/*
 * Copyright (c) 2025 tinyVision.ai Inc.
 *
 * SPDX-License-Identifier: Apache-2.0
 */

#include <riscv/tinyvision/add_csi1.dtsi>
#include <riscv/tinyvision/add_stats1.dtsi>

&csi1_ep_out1 {
	remote-endpoint-label = "stats1_ep_in";
};

&stats1_ep_in {
	remote-endpoint-label = "csi1_ep_out1";
};
