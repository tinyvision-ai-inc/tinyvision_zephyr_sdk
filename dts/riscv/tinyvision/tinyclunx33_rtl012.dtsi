/*
 * Copyright (c) 2024 tinyVision.ai Inc.
 *
 * SPDX-License-Identifier: Apache-2.0
 */

#include "tinyclunx33_add_base.dtsi"
#include "tinyclunx33_add_opencores_i2c.dtsi"
#include "tinyclunx33_add_uvcmanager0.dtsi"
#include "tinyclunx33_add_debayer0.dtsi"
#include "tinyclunx33_add_uvcmanager1.dtsi"
#include "tinyclunx33_add_debayer1.dtsi"
