/*
 * Copyright (c) 2024 tinyVision.ai Inc.
 *
 * SPDX-License-Identifier: Apache-2.0
 */

&i2c0 {
	status = "okay";

	pll: si5351@60 {
		compatible = "skyworks,si5351";
		reg = <0x60>;
		#clock-cells = <0>;
	};
};
