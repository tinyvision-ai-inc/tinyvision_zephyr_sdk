/*
 * Copyright (c) 2025 tinyVision.ai Inc.
 *
 * SPDX-License-Identifier: Apache-2.0
 */

#include <riscv/tinyvision/add_csi0.dtsi>
#include <riscv/tinyvision/add_stats0.dtsi>

&csi0_ep_out1 {
	remote-endpoint-label = "stats0_ep_in";
};

&stats0_ep_in {
	remote-endpoint-label = "csi0_ep_out1";
};
