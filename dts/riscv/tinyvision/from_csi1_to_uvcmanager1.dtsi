/*
 * Copyright (c) 2025 tinyVision.ai Inc.
 *
 * SPDX-License-Identifier: Apache-2.0
 */

#include <riscv/tinyvision/add_csi1.dtsi>
#include <riscv/tinyvision/add_uvcmanager1.dtsi>

&csi1_ep_out2 {
	remote-endpoint-label = "uvcmanager1_ep_in";
};

&uvcmanager1_ep_in {
	remote-endpoint-label = "csi1_ep_out2";
};
