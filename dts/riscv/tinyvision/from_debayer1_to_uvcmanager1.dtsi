/*
 * Copyright (c) 2025 tinyVision.ai Inc.
 *
 * SPDX-License-Identifier: Apache-2.0
 */

#include <riscv/tinyvision/add_debayer1.dtsi>
#include <riscv/tinyvision/add_uvcmanager1.dtsi>

&uvcmanager1_ep_in {
	remote-endpoint-label = "debayer1_ep_out";
};

&debayer1_ep_out {
	remote-endpoint-label = "uvcmanager1_ep_in";
};
