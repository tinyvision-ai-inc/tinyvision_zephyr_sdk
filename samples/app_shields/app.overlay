/*
 * Copyright (c) 2025 tinyVision.ai Inc.
 *
 * SPDX-License-Identifier: Apache-2.0
 */

#include <riscv/tinyvision/from_csi0_to_stats0.dtsi>
#include <riscv/tinyvision/from_csi0_to_debayer0.dtsi>
#include <riscv/tinyvision/from_debayer0_to_uvcmanager0.dtsi>

&zephyr_udc0 {
	num-in-endpoints = <2>;
	num-out-endpoints = <1>;
	status = "okay";

	uvc0: uvc0 {
		compatible = "zephyr,uvc-device";
		interface-name = "tinyCLUNX33-Camera0";
	};
};

&uvcmanager0 {
	usb-endpoint = <0x81>;
};
