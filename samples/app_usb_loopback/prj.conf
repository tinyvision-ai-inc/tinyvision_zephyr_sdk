## prj.conf
```kconfig
CONFIG_MINIMAL_LIBC=y
CONFIG_ASSERT=y
CONFIG_SERIAL=y

# SHELL
CONFIG_SHELL=y
CONFIG_I2C_SHELL=y
CONFIG_KERNEL_SHELL=y
CONFIG_SHELL_BACKEND_SERIAL_API_INTERRUPT_DRIVEN=y
CONFIG_SHELL_BACKEND_SERIAL_TX_RING_BUFFER_SIZE=64

# USB
CONFIG_UDC_DRIVER=y
CONFIG_USB_DEVICE_STACK_NEXT=y

# LOG
CONFIG_LOG=y
CONFIG_LOG_MODE_MINIMAL=y
CONFIG_UDC_DRIVER_LOG_LEVEL_INF=y
CONFIG_USBD_LOG_LEVEL_DBG=y
CONFIG_USBD_VIDEO_LOG_LEVEL_DBG=y
CONFIG_MINIMAL_LIBC_STRING_ERROR_TABLE=y
```

## src/main.c
```c
int app_usb_init(void);

int main(void)
{
	return app_usb_init();
}
```
