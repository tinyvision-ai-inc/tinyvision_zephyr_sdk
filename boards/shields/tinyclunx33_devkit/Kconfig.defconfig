## boards/shields/tinyclunx33_devkit/Kconfig.defconfig
```kconfig
# Copyright (c) 2024 tinyVision.ai Inc.
# SPDX-License-Identifier: Apache-2.0

config SERIAL
	default y

config CONSOLE
	default y

config UART_CONSOLE
	default y

config UART_LINE_CTRL
	default y
```

## boards/shields/tinyclunx33_devkit/Kconfig.shield
```kconfig
# Copyright (c) 2024 tinyVision.ai Inc.
# SPDX-License-Identifier: Apache-2.0

config SHIELD_TINYCLUNX33_DEVKIT_REV1
	def_bool $(shields_list_contains,tinyclunx33_devkit_rev1)

config SHIELD_TINYCLUNX33_DEVKIT_REV2
	def_bool $(shields_list_contains,tinyclunx33_devkit_rev2)
```

## boards/tinyvision/tinyclunx33/Kconfig.defconfig
```kconfig
# Copyright (c) 2024 tinyVision.ai Inc.
# SPDX-License-Identifier: Apache-2.0

# Workaround for not being able to have commas in macro arguments
DT_CHOSEN_Z_CODE_PARTITION := zephyr,code-partition

config HAS_FLASH_LOAD_OFFSET
	default y

config FLASH_LOAD_SIZE
	default $(dt_chosen_reg_size_hex,$(DT_CHOSEN_Z_CODE_PARTITION))

config FLASH_LOAD_OFFSET
	default $(dt_chosen_reg_addr_hex,$(DT_CHOSEN_Z_CODE_PARTITION))

config XIP
	default y

config SERIAL
	default y

config CONSOLE
	default y

config UART_CONSOLE
	default y

config UART_LINE_CTRL
	default y
```

## boards/tinyvision/tinyclunx33/Kconfig.tinyclunx33
```kconfig
# Copyright (c) 2024 tinyVision.ai Inc.
# SPDX-License-Identifier: Apache-2.0

config BOARD_TINYCLUNX33
	select SOC_TINYCLUNX33_CUSTOM if BOARD_TINYCLUNX33_CUSTOM
	select SOC_TINYCLUNX33_RTL008 if BOARD_TINYCLUNX33_RTL008
	select SOC_TINYCLUNX33_RTL009 if BOARD_TINYCLUNX33_RTL009
	select SOC_TINYCLUNX33_RTL010 if BOARD_TINYCLUNX33_RTL010
	select SOC_TINYCLUNX33_RTL011 if BOARD_TINYCLUNX33_RTL011
```

## drivers/spi/Kconfig
```kconfig
# Copyright (c) 2025 tinyVision.ai Inc.
# SPDX-License-Identifier: Apache-2.0

if SPI

rsource "Kconfig.tinyvision"

endif
```

## drivers/spi/Kconfig.tinyvision
```kconfig
config SPI_TINYVISION
	bool "tinyVision SPI driver"
	default y
	depends on DT_HAS_TINYVISION_SPI_ENABLED
	help
	  Enable support for tinyVision SPI driver
```

## drivers/video/Kconfig
```kconfig
# Copyright (c) 2024 tinyVision.ai Inc.
# SPDX-License-Identifier: Apache-2.0

if VIDEO

config VIDEO_I2C_RETRY_NUM
	int "Number of attempts for retrying I2C communication if it failed"
	default 3
	help
	  The default is there to reduce the chance of failure (i.e. occasional EMI) without
	  flooding the I2C bus upon error with too many retries. There is a 1ms wait time between
	  every retry.

rsource "Kconfig.debayer"
rsource "Kconfig.dphy_rx"
rsource "Kconfig.imx219"
rsource "Kconfig.imx296"
rsource "Kconfig.imx477"
rsource "Kconfig.shell"
rsource "Kconfig.testpattern"
rsource "Kconfig.uvcmanager"

endif
```

## drivers/video/Kconfig.debayer
```kconfig
# Copyright (c) 2024 tinyVision.ai Inc.
# SPDX-License-Identifier: Apache-2.0

config VIDEO_TINYVISION_DEBAYER
	bool "debayer present on tinyVision.ai designs"
	depends on DT_HAS_TINYVISION_DEBAYER_ENABLED
	default y
	help
	  Enable driver for the tinyVision.ai debayer block.
	  This driver does not do any hardware I/O and only describes the
	  properties of the peripheral.
```

## drivers/video/Kconfig.imx296
```kconfig
# Copyright (c) 2024 tinyVision.ai Inc.
# SPDX-License-Identifier: Apache-2.0

config VIDEO_IMX296
	bool "IMX296 1.58 Mega-Pixel CMOS global shutter image sensor"
	select I2C
	depends on DT_HAS_SONY_IMX296_ENABLED
	default y
```

## drivers/video/Kconfig.imx477
```kconfig
# Copyright (c) 2025 tinyVision.ai Inc.
# SPDX-License-Identifier: Apache-2.0

config VIDEO_IMX477
	bool "IMX477 8 Mega-Pixel CMOS image sensor"
	select I2C
	depends on DT_HAS_SONY_IMX477_ENABLED
	default y
	help
	  Enable driver for IMX477 12.3 Mega-Pixel CMOS Image Sensor
```

## dts/bindings/spi/tinyvision,spi.yaml
```yaml
# Copyright (c) 2025 tinyVision.ai
# SPDX-License-Identifier: Apache-2.0

description: tinyVision.ai SPI

compatible: "tinyvision,spi"

include: spi-controller.yaml

properties:
  reg:
    required: true
```

## dts/bindings/video/onnn,ar0144.yaml
```yaml
description: AR0144 CMOS image sensor

compatible: "onnn,ar0144"

include: i2c-device.yaml
```

## dts/bindings/video/sony,imx219.yaml
```yaml
# Copyright (c) 2025 tinyVIsion.ai Inc.
# SPDX-License-Identifier: Apache-2.0

description: IMX219 8 Mega-Pixel CMOS image sensor

compatible: "sony,imx219"

include: i2c-device.yaml

properties:
  clocks:
    description: Reference Input clock
    required: true

child-binding:
  child-binding:
    include: video-interfaces.yaml
```

## dts/bindings/video/sony,imx296.yaml
```yaml
description: IMX296 1.58 Mega-Pixel CMOS global shutter image sensor

compatible: "sony,imx296"

include: i2c-device.yaml

child-binding:
  child-binding:
    include: video-interfaces.yaml
```

## dts/bindings/video/sony,imx477.yaml
```yaml
description: IMX477 12.3 Mega-Pixel CMOS Image Sensor

compatible: "sony,imx477"

include: i2c-device.yaml

child-binding:
  child-binding:
    include: video-interfaces.yaml
```

## soc/tinyvision/tinyclunx33/Kconfig.defconfig
```kconfig
# Copyright (c) 2024, tinyVision.ai Inc.
# SPDX-License-Identifier: Apache-2.0

if SOC_SERIES_TINYCLUNX33

config SYS_CLOCK_HW_CYCLES_PER_SEC
	default 80000000
	default 100000000 if SOC_TINYCLUNX33_RTL009

config NUM_IRQS
	default 12

config SHELL_BACKEND_SERIAL_CHECK_DTR
	# Usability fix: wait that the client connects
	default y

config UDC_BUF_FORCE_NOCACHE
	# All UDC net_buf buffers needs to be put in the .nocache section to
	# work with DMA, as the DWC3 core cannot access main RAM.
	default y

endif # SOC_SERIES_TINYCLUNX33
```

## soc/tinyvision/tinyclunx33/Kconfig.soc
```kconfig
# Copyright (c) 2024 tinyVision.ai Inc.
# SPDX-License-Identifier: Apache-2.0

config SOC_SERIES_TINYCLUNX33
	bool "tinyCLUNX33 RTL-basd SoC"
	help
	  Each SoC under this series is a release of an FPGA RTL ("gateware")
	  that implements the virtual SoC loaded onto the FPGA. They are
	  published by tinyVision.ai.

config SOC_TINYCLUNX33_CUSTOM
	bool "tinyCLUNX33 custom RTL"
	select SOC_SERIES_TINYCLUNX33
	help
	  This SoC is a placeholder for application-specific designs, where
	  the peripheral definition is done in the app.overlay directly.
	  This is a good starting point for a custom FPGA design.

config SOC_TINYCLUNX33_RTL_0_8
	bool "tinyCLUNX33 RTL v0.8 release"
	select SOC_SERIES_TINYCLUNX33
	help
	  This SoC lacks MIPI support, but features a test pattern generator
	  to test the USB bandwidth.

config SOC_TINYCLUNX33_RTL_0_9
	bool "tinyCLUNX33 RTL v0.9 release"
	select SOC_SERIES_TINYCLUNX33
	help
	  This SoC introduces MIPI support.

config SOC_TINYCLUNX33_RTL_0_10
	bool "tinyCLUNX33 RTL v0.10 release"
	select SOC_SERIES_TINYCLUNX33
	help
	  The tinyCLUNX33 RTL v0.10 release.

config SOC_TINYCLUNX33_RTL_0_11
	bool "tinyCLUNX33 RTL v0.11 release"
	select SOC_SERIES_TINYCLUNX33
	help
	  The tinyCLUNX33 RTL v0.11 release.

config SOC_TINYCLUNX33_RTL_1_0_2
	bool "tinyCLUNX33 RTL v1.0.2 release"
	select SOC_SERIES_TINYCLUNX33
	help
	  The tinyCLUNX33 RTL v1.0.2 release.

config SOC_SERIES
	default "tinyclunx33" if SOC_SERIES_TINYCLUNX33

config SOC
	default "custom" if SOC_TINYCLUNX33_CUSTOM
	default "rtl_0_8" if SOC_TINYCLUNX33_RTL_0_8
	default "rtl_0_9" if SOC_TINYCLUNX33_RTL_0_9
	default "rtl_0_10" if SOC_TINYCLUNX33_RTL_0_10
	default "rtl_0_11" if SOC_TINYCLUNX33_RTL_0_11
	default "rtl_1_0_2" if SOC_TINYCLUNX33_RTL_1_0_2
```

## subsys/usb/device_next/Kconfig
```kconfig
# Copyright (c) 2024 tinyVision.ai Inc.
# SPDX-License-Identifier: Apache-2.0

if USB_DEVICE_STACK_NEXT

rsource "class/Kconfig.uvc"

endif # USB_DEVICE_STACK_NEXT
```

## tests/usb/testcase.yaml
```yaml
common:
  tags: usbd
  integration_platforms:
    - tinyclunx33@rev2/rtl_0_10
tests:
  usb.enumeration: {}
```

## west.yml
```yaml
# Copyright (c) 2023-2024 tinyVision.ai Inc.
# SPDX-License-Identifier: MIT

manifest:
  projects:

    - name: zephyr
      url: git@github.com:tinyvision-ai-inc/zephyr
      revision: v4.2.0-rc3
      import:
        name-allowlist:
          - zephyr
```
