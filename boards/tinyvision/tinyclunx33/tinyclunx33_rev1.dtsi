/*
 * Copyright (c) 2024 tinyVision.ai Inc.
 *
 * SPDX-License-Identifier: Apache-2.0
 */

&i2c0 {
	status = "okay";

	pll0: si5351@60 {
		reg = <0x60>;
		compatible = "skyworks,si5351";
		#clock-cells = <0>;
		status = "okay";
	};
};
